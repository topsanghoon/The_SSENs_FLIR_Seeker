/ {
};

&amba_pl { 
    axi_quad_spi@41e00000 {
        status = "okay";
        spidev@0 {
            compatible = "rohm,dh2228fv";
            reg = <0>;                      /* CS0 */
            spi-max-frequency = <16000000>;
            spi-cpol;                       /* Mode 3 */
            spi-cpha;
        };
    };
};
